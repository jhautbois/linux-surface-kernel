## west.yml
```yaml
# The west manifest file for upstream linux-kernel-configs.
#

manifest:
  defaults:
    remote: upstream

  remotes:
    - name: upstream
      url-base: https://github.com/jhautbois

  #
  # Please add items below based on alphabetical order
  projects:
    - name: kernel-configs
      revision: 85e4540966507b617c09f47eeb15d2e59ed25c99
      path: kernel-configs
    - name: linux
      revision: v5.8
      path: linux-kernel-surface/linux
    - name: linux-surface
      revision: b15168b83cc8b2fe084e6088aeddd45b0f66179c
      path: linux-surface

  self:
    path: linux-surface-kernel
    west-commands: scripts/west-commands.yml
```
